AUTOSAR XML (schema 4-2-2)
package /KPIT/EcucDescription
  ecuc value collection DefaultEcucValueCollection: ecuc-values=[BswM_0, Can_0]
  module config BswM_0: definition=BswM, ecuc-def-edition=4.6.0, implementation-config-variant=VARIANT-PRE-COMPILE, module-description=BSWM_Impl
    BswMConfig_0 (BswMConfig)
      BswMArbitration_0 (BswMArbitration)
        MRP_EcuMIndication (BswMModeRequestPort): BswMRequestProcessing=BSWM_IMMEDIATE
          BswMModeRequestSource_0 (BswMModeRequestSource)
            BswMEcuMIndication_0 (BswMEcuMIndication)
        MC_EcuMIndication_StartUp (BswMModeCondition): BswMConditionType=BSWM_EQUALS, BswMConditionMode=MRP_EcuMIndication
          BswMConditionValue_0 (BswMConditionValue)
            BswMBswMode_0 (BswMBswMode): BswMBswRequestedMode=ECUM_STATE_STARTUP
        LE_EcuMIndication_StartUp (BswMLogicalExpression): BswMArgumentRef=MC_EcuMIndication_StartUp
        Rule_EcuMIndication_StartUp (BswMRule):
          BswMNestedExecutionOnly = false
          BswMRuleInitState = BSWM_FALSE
          BswMRuleExpressionRef = LE_EcuMIndication_StartUp
          BswMRuleTrueActionList = AL_InitListTwo
        MRP_NvMIndication_ReadAll (BswMModeRequestPort): BswMRequestProcessing=BSWM_IMMEDIATE
          BswMModeRequestSource_0 (BswMModeRequestSource)
            BswMNvMJobModeIndication_0 (BswMNvMJobModeIndication): BswMNvmService=NvmReadAll
        MC_NvMIndication_ReadAllOK (BswMModeCondition): BswMConditionType=BSWM_EQUALS, BswMConditionMode=MRP_NvMIndication_ReadAll
          BswMConditionValue_0 (BswMConditionValue)
            BswMBswMode_0 (BswMBswMode): BswMBswRequestedMode=NVM_REQ_OK
        LE_EcuMNvMIndication_StartUpReadAll (BswMLogicalExpression): BswMLogicalOperator=BSWM_AND, BswMArgumentRef=MC_EcuMIndication_StartUp, BswMArgumentRef=MC_NvMIndication_ReadAllOK
        Rule_EcuMNvMIndication_StartUpReadAll (BswMRule):
          BswMNestedExecutionOnly = false
          BswMRuleInitState = BSWM_FALSE
          BswMRuleExpressionRef = LE_EcuMNvMIndication_StartUpReadAll
          BswMRuleTrueActionList = AL_InitListThree
        MRP_EcuMRUNRequestIndication_RUN (BswMModeRequestPort): BswMRequestProcessing=BSWM_IMMEDIATE
          BswMModeRequestSource_0 (BswMModeRequestSource)
            BswMEcuMRUNRequestIndication_0 (BswMEcuMRUNRequestIndication): BswMEcuMRUNRequestProtocolPort=RUN
        MC_EcuMRUNRequestIndicationRELEASED (BswMModeCondition): BswMConditionType=BSWM_EQUALS, BswMConditionMode=MRP_EcuMRUNRequestIndication_RUN
          BswMConditionValue_0 (BswMConditionValue)
            BswMBswMode_0 (BswMBswMode): BswMBswRequestedMode=ECUM_RUNSTATUS_RELEASED
        MC_EcuMIndication_APP_RUN (BswMModeCondition): BswMConditionType=BSWM_EQUALS, BswMConditionMode=MRP_EcuMIndication
          BswMConditionValue_0 (BswMConditionValue)
            BswMBswMode_0 (BswMBswMode): BswMBswRequestedMode=ECUM_STATE_APP_RUN
        LE_EcuMIndicationAppRun_RunReqRelease (BswMLogicalExpression): BswMLogicalOperator=BSWM_AND, BswMArgumentRef=MC_EcuMRUNRequestIndicationRELEASED, BswMArgumentRef=MC_EcuMIndication_APP_RUN
        Rule_EcuMIndicationAppRun_RunReqRelease (BswMRule):
          BswMNestedExecutionOnly = false
          BswMRuleInitState = BSWM_FALSE
          BswMRuleExpressionRef = LE_EcuMIndicationAppRun_RunReqRelease
          BswMRuleTrueActionList = AL_ComMAllowedFalseAndEcuMStateSwitch
        MRP_EcuMRUNRequestIndication_POSTRUN (BswMModeRequestPort): BswMRequestProcessing=BSWM_IMMEDIATE
          BswMModeRequestSource_0 (BswMModeRequestSource)
            BswMEcuMRUNRequestIndication_0 (BswMEcuMRUNRequestIndication): BswMEcuMRUNRequestProtocolPort=POST_RUN
        MC_EcuMPOSTRUNRequestIndicationRELEASED (BswMModeCondition): BswMConditionType=BSWM_EQUALS, BswMConditionMode=MRP_EcuMRUNRequestIndication_POSTRUN
          BswMConditionValue_0 (BswMConditionValue)
            BswMBswMode_0 (BswMBswMode): BswMBswRequestedMode=ECUM_RUNSTATUS_RELEASED
        MC_EcuMIndication_App_Post_Run (BswMModeCondition): BswMConditionType=BSWM_EQUALS, BswMConditionMode=MRP_EcuMIndication
          BswMConditionValue_0 (BswMConditionValue)
            BswMBswMode_0 (BswMBswMode): BswMBswRequestedMode=ECUM_STATE_APP_POST_RUN
        LE_EcuMSleep (BswMLogicalExpression): BswMLogicalOperator=BSWM_AND, BswMArgumentRef=MC_EcuMPOSTRUNRequestIndicationRELEASED, BswMArgumentRef=MC_EcuMIndication_App_Post_Run
        Rule_EcuMSleepGoPoll (BswMRule): BswMNestedExecutionOnly=false, BswMRuleInitState=BSWM_FALSE, BswMRuleExpressionRef=LE_EcuMSleep, BswMRuleTrueActionList=AL_EcuMGoPoll
        MRP_CanCommunicationGenericRequest (BswMModeRequestPort): BswMRequestProcessing=BSWM_IMMEDIATE
          BswMModeRequestSource_0 (BswMModeRequestSource)
            BswMGenericRequest_0 (BswMGenericRequest): BswMModeRequesterId=0, BswMRequestedModeMax=80
        MC_CanFullComGenericRequest (BswMModeCondition): BswMConditionType=BSWM_EQUALS, BswMConditionMode=MRP_CanCommunicationGenericRequest
          BswMConditionValue_0 (BswMConditionValue)
            BswMBswMode_0 (BswMBswMode): BswMBswRequestedMode=0x32
        LE_CanFullComGenericRequest (BswMLogicalExpression): BswMArgumentRef=MC_CanFullComGenericRequest
        Rule_CanFullComGenericRequest (BswMRule):
          BswMNestedExecutionOnly = false
          BswMRuleInitState = BSWM_FALSE
          BswMRuleExpressionRef = LE_CanFullComGenericRequest
          BswMRuleTrueActionList = AL_CanFullCom
        MC_CanNoComGenericRequest (BswMModeCondition): BswMConditionType=BSWM_EQUALS, BswMConditionMode=MRP_CanCommunicationGenericRequest
          BswMConditionValue_0 (BswMConditionValue)
            BswMBswMode_0 (BswMBswMode): BswMBswRequestedMode=0x33
        LE_CanNoComGenericRequest (BswMLogicalExpression): BswMArgumentRef=MC_CanNoComGenericRequest
        Rule_CanNoComGenericRequest (BswMRule): BswMNestedExecutionOnly=false, BswMRuleInitState=BSWM_FALSE, BswMRuleExpressionRef=LE_CanNoComGenericRequest, BswMRuleTrueActionList=AL_CanNoCom
        MRP_CanSMIndication_ComMChannel_CAN1 (BswMModeRequestPort): BswMRequestProcessing=BSWM_IMMEDIATE
          BswMModeRequestSource_0 (BswMModeRequestSource)
            BswMCanSMIndication_0 (BswMCanSMIndication): BswMCanSMChannelRef=(unset)
        MC_CanSMFullComIndication_ComMChannel_CAN1 (BswMModeCondition): BswMConditionType=BSWM_EQUALS, BswMConditionMode=MRP_CanSMIndication_ComMChannel_CAN1
          BswMConditionValue_0 (BswMConditionValue)
            BswMBswMode_0 (BswMBswMode): BswMBswRequestedMode=CANSM_BSWM_FULL_COMMUNICATION
        LE_CanSMFullComIndication_ComMChannel_CAN1 (BswMLogicalExpression): BswMArgumentRef=MC_CanSMFullComIndication_ComMChannel_CAN1
        Rule_CanSMFullComIndication_ComMChannel_CAN1 (BswMRule):
          BswMNestedExecutionOnly = false
          BswMRuleInitState = BSWM_FALSE
          BswMRuleExpressionRef = LE_CanSMFullComIndication_ComMChannel_CAN1
          BswMRuleTrueActionList = AL_EnablePduGroup_ComMChannel_CAN1
        MC_CanSMNoComIndication_ComMChannel_CAN1 (BswMModeCondition): BswMConditionType=BSWM_EQUALS, BswMConditionMode=MRP_CanSMIndication_ComMChannel_CAN1
          BswMConditionValue_0 (BswMConditionValue)
            BswMBswMode_0 (BswMBswMode): BswMBswRequestedMode=CANSM_BSWM_NO_COMMUNICATION
        LE_CanSMNoComIndication_ComMChannel_CAN1 (BswMLogicalExpression): BswMArgumentRef=MC_CanSMNoComIndication_ComMChannel_CAN1
        Rule_CanSMNoComIndication_ComMChannel_CAN1 (BswMRule):
          BswMNestedExecutionOnly = false
          BswMRuleInitState = BSWM_FALSE
          BswMRuleExpressionRef = LE_CanSMNoComIndication_ComMChannel_CAN1
          BswMRuleTrueActionList = AL_DisablePduGroup_ComMChannel_CAN1
        MRP_ComMIndication_ComMChannel_CAN1 (BswMModeRequestPort): BswMRequestProcessing=BSWM_IMMEDIATE
          BswMModeRequestSource_0 (BswMModeRequestSource)
            BswMComMIndication_0 (BswMComMIndication): BswMComMChannelRef=(unset)
        MC_ComMFullComIndication_ComMChannel_CAN1 (BswMModeCondition): BswMConditionType=BSWM_EQUALS, BswMConditionMode=MRP_ComMIndication_ComMChannel_CAN1
          BswMConditionValue_0 (BswMConditionValue)
            BswMBswMode_0 (BswMBswMode): BswMBswRequestedMode=COMM_FULL_COMMUNICATION
        LE_ComMFullComIndication_ComMChannel_CAN1 (BswMLogicalExpression): BswMArgumentRef=MC_ComMFullComIndication_ComMChannel_CAN1
        Rule_ComMFullComIndication_ComMChannel_CAN1 (BswMRule):
          BswMNestedExecutionOnly = false
          BswMRuleInitState = BSWM_FALSE
          BswMRuleExpressionRef = LE_ComMFullComIndication_ComMChannel_CAN1
          BswMRuleTrueActionList = (unset)
        MC_ComMNoComIndication_ComMChannel_CAN1 (BswMModeCondition): BswMConditionType=BSWM_EQUALS, BswMConditionMode=MRP_ComMIndication_ComMChannel_CAN1
          BswMConditionValue_0 (BswMConditionValue)
            BswMBswMode_0 (BswMBswMode): BswMBswRequestedMode=COMM_NO_COMMUNICATION
        LE_ComMNoComIndication_ComMChannel_CAN1 (BswMLogicalExpression): BswMArgumentRef=MC_ComMNoComIndication_ComMChannel_CAN1
        Rule_ComMNoComIndication_ComMChannel_CAN1 (BswMRule):
          BswMNestedExecutionOnly = false
          BswMRuleInitState = BSWM_FALSE
          BswMRuleExpressionRef = LE_ComMNoComIndication_ComMChannel_CAN1
          BswMRuleTrueActionList = (unset)
      BswMModeControl_0 (BswMModeControl)
        AL_InitListTwo (BswMActionList): BswMActionListExecution=BSWM_TRIGGER
          3 x BswMActionListItem, all with BswMAbortOnFail=false:
            BswMActionListItem_0: BswMActionListItemIndex=0, BswMActionListItemRef=BswMAction_0
            BswMActionListItem_1: BswMActionListItemIndex=1, BswMActionListItemRef=BswMAction_1
            BswMActionListItem_2: BswMActionListItemIndex=2, BswMActionListItemRef=AC_ComMAllowedTrue_ComMChannel_CAN1
        3 x BswMAction:
          BswMAction_0
            BswMAvailableActions_0 (BswMAvailableActions)
              BswMUserCallout_0 (BswMUserCallout): BswMUserCalloutFunction=Can_Init(NULL_PTR)
          BswMAction_1
            BswMAvailableActions_0 (BswMAvailableActions)
              BswMUserCallout_0 (BswMUserCallout): BswMUserCalloutFunction=Rte_Start()
          AC_EcuM_SetState_APP_RUN
            BswMAvailableActions_0 (BswMAvailableActions)
              BswMEcuMStateSwitch_0 (BswMEcuMStateSwitch): BswMEcuMState=RUN
        AL_InitListThree (BswMActionList): BswMActionListExecution=BSWM_TRIGGER
          BswMActionListItem_0 (BswMActionListItem): BswMAbortOnFail=false, BswMActionListItemIndex=0, BswMActionListItemRef=BswMAction_2
          BswMActionListItem_1 (BswMActionListItem): BswMAbortOnFail=false, BswMActionListItemIndex=1, BswMActionListItemRef=BswMAction_3
        BswMAction_2 (BswMAction)
          BswMAvailableActions_0 (BswMAvailableActions)
            BswMUserCallout_0 (BswMUserCallout): BswMUserCalloutFunction=Com_Init(NULL_PTR)
        BswMAction_3 (BswMAction)
          BswMAvailableActions_0 (BswMAvailableActions)
            BswMUserCallout_0 (BswMUserCallout): BswMUserCalloutFunction=PduR_Init(NULL_PTR)
        AL_CanFullCom (BswMActionList): BswMActionListExecution=BSWM_TRIGGER
          BswMActionListItem_0 (BswMActionListItem): BswMAbortOnFail=false, BswMActionListItemIndex=0, BswMActionListItemRef=AC_ComMFullCom_ComMChannel_CAN1
        AL_CanNoCom (BswMActionList): BswMActionListExecution=BSWM_TRIGGER
          BswMActionListItem_0 (BswMActionListItem): BswMAbortOnFail=false, BswMActionListItemIndex=0, BswMActionListItemRef=AC_ComMNoCom_ComMChannel_CAN1
        3 x BswMAction:
          AC_ComMFullCom_ComMChannel_CAN1
            BswMAvailableActions_0 (BswMAvailableActions)
              BswMComMModeSwitch_0 (BswMComMModeSwitch): BswMComMRequestedMode=BSWM_FULL_COM, BswMComMUserRef=(unset)
          AC_ComMNoCom_ComMChannel_CAN1
            BswMAvailableActions_0 (BswMAvailableActions)
              BswMComMModeSwitch_0 (BswMComMModeSwitch): BswMComMRequestedMode=BSWM_NO_COM, BswMComMUserRef=(unset)
          AC_ComMAllowedTrue_ComMChannel_CAN1
            BswMAvailableActions_0 (BswMAvailableActions)
              BswMComMAllowCom_0 (BswMComMAllowCom): BswMComAllowed=true, BswMComMAllowChannelRef=(unset)
        AL_EnablePduGroup_ComMChannel_CAN1 (BswMActionList): BswMActionListExecution=BSWM_CONDITION
          BswMActionListItem_0 (BswMActionListItem): BswMAbortOnFail=false, BswMActionListItemIndex=0, BswMActionListItemRef=AC_EnablePduGroup_ComMChannel_CAN1
        AC_EnablePduGroup_ComMChannel_CAN1 (BswMAction)
          BswMAvailableActions_0 (BswMAvailableActions)
            BswMPduGroupSwitch_0 (BswMPduGroupSwitch): BswMEnabledPduGroupRef=(unset), BswMEnabledPduGroupRef=(unset)
        AL_DisablePduGroup_ComMChannel_CAN1 (BswMActionList): BswMActionListExecution=BSWM_TRIGGER
          BswMActionListItem_0 (BswMActionListItem): BswMAbortOnFail=false, BswMActionListItemIndex=0, BswMActionListItemRef=AC_DisablePduGroup_ComMChannel_CAN1
        AC_DisablePduGroup_ComMChannel_CAN1 (BswMAction)
          BswMAvailableActions_0 (BswMAvailableActions)
            BswMPduGroupSwitch_0 (BswMPduGroupSwitch): BswMDisabledPduGroupRef=(unset), BswMDisabledPduGroupRef=(unset)
        AL_ComMAllowedFalseAndEcuMStateSwitch (BswMActionList): BswMActionListExecution=BSWM_TRIGGER
          BswMActionListItem_0 (BswMActionListItem): BswMAbortOnFail=false, BswMActionListItemIndex=0, BswMActionListItemRef=AC_ComMAllowedFalse_ComMChannel_CAN1
          BswMActionListItem_1 (BswMActionListItem): BswMAbortOnFail=false, BswMActionListItemIndex=1, BswMActionListItemRef=AC_EcuMStateSwitchToPOST_RUN
        AC_ComMAllowedFalse_ComMChannel_CAN1 (BswMAction)
          BswMAvailableActions_0 (BswMAvailableActions)
            BswMComMAllowCom_0 (BswMComMAllowCom): BswMComAllowed=false, BswMComMAllowChannelRef=(unset)
        AC_EcuMStateSwitchToPOST_RUN (BswMAction)
          BswMAvailableActions_0 (BswMAvailableActions)
            BswMEcuMStateSwitch_0 (BswMEcuMStateSwitch): BswMEcuMState=POST_RUN
        AL_EcuMGoPoll (BswMActionList): BswMActionListExecution=BSWM_TRIGGER
          BswMActionListItem_0 (BswMActionListItem): BswMAbortOnFail=false, BswMActionListItemIndex=0, BswMActionListItemRef=AC_ShutdownTargetSleep
        AC_ShutdownTargetSleep (BswMAction)
          BswMAvailableActions_0 (BswMAvailableActions)
            BswMEcuMSelectShutdownTarget_0 (BswMEcuMSelectShutdownTarget): BswMEcuMShutdownTarget=SLEEP, BswMEcuMSleepModeRef=(unset)
    BswMGeneral_0 (BswMGeneral):
      BswMNvMEnabled = true
      BswMEcuMEnabled = true
      BswMMainFunctionPeriod = 0.005
      BswMLinSMEnabled = false
      BswMGenericRequestEnabled = true
      BswMEthSMEnabled = false
      BswMCanSMEnabled = true
      BswMComMEnabled = true
      BswMFrSMEnabled = false
      BswMLinTPEnabled = false
      BswMCanSMIcomEnabled = false
      BswMDcmEnabled = false
      BswMDevErrorDetect = false
      BswMJ1939NmEnabled = false
      BswMSchMEnabled = false
      BswMVersionInfoApi = true
      BswMWdgMEnabled = false
      BswMSdEnabled = false
      BswMUserIncludeFiles_0 (BswMUserIncludeFiles):
        BswMUserIncludeFile = PduR.h
        BswMUserIncludeFile = CanIf.h
        BswMUserIncludeFile = Rte_Main.h
        BswMUserIncludeFile = Can.h
        BswMUserIncludeFile = ComM_EcuMBswM.h
        BswMUserIncludeFile = Nm.h
        BswMUserIncludeFile = CanSM.h
  module config Can_0: definition=Can, ecuc-def-edition=4.2.2, implementation-config-variant=VARIANT-PRE-COMPILE
    CanConfigSet_0 (CanConfigSet)
      41 x CanHardwareObject, all with CanTriggerTransmitEnable=false, CanHandleType=FULL, CanIdType=STANDARD, CanFdPaddingValue=0, CanControllerRef=CanCommunicationController_0:
        CanHardwareObject_R_CanFrame_TC32Arr8Rx_131_305: CanHwObjectCount=0, CanObjectType=RECEIVE, CanObjectId=0
          CanHwFilter_R_CanFrame_TC32Arr8Rx_131_305 (CanHwFilter): CanHwFilterMask=2049, CanHwFilterCode=2049
        CanHardwareObject_R_CanFrame_MMT_rx_202_514: CanHwObjectCount=1, CanObjectType=RECEIVE, CanObjectId=1
          CanHwFilter_R_CanFrame_MMT_rx_202_514 (CanHwFilter): CanHwFilterMask=2049, CanHwFilterCode=2049
        CanHardwareObject_R_CanFrame_MMT_rx_203_515: CanHwObjectCount=2, CanObjectType=RECEIVE, CanObjectId=2
          CanHwFilter_R_CanFrame_MMT_rx_203_515 (CanHwFilter): CanHwFilterMask=2049, CanHwFilterCode=2049
        CanHardwareObject_T_CanFrame_MMT_tx_200_512: CanHwObjectCount=3, CanObjectType=TRANSMIT, CanObjectId=17
          CanHwFilter_T_CanFrame_MMT_tx_200_512 (CanHwFilter): CanHwFilterMask=2049, CanHwFilterCode=2049
        CanHardwareObject_T_CanFrame_MMT_tx_201_513: CanHwObjectCount=4, CanObjectType=TRANSMIT, CanObjectId=18
          CanHwFilter_T_CanFrame_MMT_tx_201_513 (CanHwFilter): CanHwFilterMask=2049, CanHwFilterCode=2049
        CanHardwareObject_T_CanFrame_MMT_tx_210_528: CanHwObjectCount=5, CanObjectType=TRANSMIT, CanObjectId=19
          CanHwFilter_T_CanFrame_MMT_tx_210_528 (CanHwFilter): CanHwFilterMask=2049, CanHwFilterCode=2049
        CanHardwareObject_T_CanFrame_MMT_tx_211_529: CanHwObjectCount=6, CanObjectType=TRANSMIT, CanObjectId=20
          CanHwFilter_T_CanFrame_MMT_tx_211_529 (CanHwFilter): CanHwFilterMask=2049, CanHwFilterCode=2049
        CanHardwareObject_R_CanFrame_NmPdu_RX_2032: CanHwObjectCount=7, CanObjectType=RECEIVE, CanObjectId=3
          CanHwFilter_R_CanFrame_NmPdu_RX_2032 (CanHwFilter): CanHwFilterMask=2049, CanHwFilterCode=2049
        CanHardwareObject_T_CanFrame_NmPdu_TX_2033: CanHwObjectCount=8, CanObjectType=TRANSMIT, CanObjectId=21
          CanHwFilter_T_CanFrame_NmPdu_TX_2033 (CanHwFilter): CanHwFilterMask=2049, CanHwFilterCode=2049
        CanHardwareObject_T_CanFrame_TC13U8Tx_126_294: CanHwObjectCount=9, CanObjectType=TRANSMIT, CanObjectId=22
          CanHwFilter_T_CanFrame_TC13U8Tx_126_294 (CanHwFilter): CanHwFilterMask=2049, CanHwFilterCode=2049
        CanHardwareObject_T_CanFrame_TC14Arr8Tx_127_295: CanHwObjectCount=10, CanObjectType=TRANSMIT, CanObjectId=23
          CanHwFilter_T_CanFrame_TC14Arr8Tx_127_295 (CanHwFilter): CanHwFilterMask=2049, CanHwFilterCode=2049
        CanHardwareObject_R_CanFrame_TC15U8RxInv_128_296: CanHwObjectCount=11, CanObjectType=RECEIVE, CanObjectId=4
          CanHwFilter_R_CanFrame_TC15U8RxInv_128_296 (CanHwFilter): CanHwFilterMask=2049, CanHwFilterCode=2049
        CanHardwareObject_R_CanFrame_TC16U8RxInvReplace_129_297: CanHwObjectCount=12, CanObjectType=RECEIVE, CanObjectId=5
          CanHwFilter_R_CanFrame_TC16U8RxInvReplace_129_297 (CanHwFilter): CanHwFilterMask=2049, CanHwFilterCode=2049
        CanHardwareObject_R_CanFrame_TC17ArrRx_12A_298: CanHwObjectCount=13, CanObjectType=RECEIVE, CanObjectId=6
          CanHwFilter_R_CanFrame_TC17ArrRx_12A_298 (CanHwFilter): CanHwFilterMask=2049, CanHwFilterCode=2049
        CanHardwareObject_R_CanFrame_TC18ArrRx_12B_299: CanHwObjectCount=14, CanObjectType=RECEIVE, CanObjectId=7
          CanHwFilter_R_CanFrame_TC18ArrRx_12B_299 (CanHwFilter): CanHwFilterMask=2049, CanHwFilterCode=2049
        CanHardwareObject_T_CanFrame_TC19U8Tx_12C_300: CanHwObjectCount=15, CanObjectType=TRANSMIT, CanObjectId=24
          CanHwFilter_T_CanFrame_TC19U8Tx_12C_300 (CanHwFilter): CanHwFilterMask=2049, CanHwFilterCode=2049
        CanHardwareObject_T_CanFrame_TC20U8Tx_12D_301: CanHwObjectCount=16, CanObjectType=TRANSMIT, CanObjectId=25
          CanHwFilter_T_CanFrame_TC20U8Tx_12D_301 (CanHwFilter): CanHwFilterMask=2049, CanHwFilterCode=2049
        CanHardwareObject_T_CanFrame_TC21U8Tx_250_592: CanHwObjectCount=17, CanObjectType=TRANSMIT, CanObjectId=26
          CanHwFilter_T_CanFrame_TC21U8Tx_250_592 (CanHwFilter): CanHwFilterMask=2049, CanHwFilterCode=2049
        CanHardwareObject_T_CanFrame_TC22U8Tx_251_593: CanHwObjectCount=18, CanObjectType=TRANSMIT, CanObjectId=27
          CanHwFilter_T_CanFrame_TC22U8Tx_251_593 (CanHwFilter): CanHwFilterMask=2049, CanHwFilterCode=2049
        CanHardwareObject_T_CanFrame_TC23U8Tx_149_329: CanHwObjectCount=19, CanObjectType=TRANSMIT, CanObjectId=28
          CanHwFilter_T_CanFrame_TC23U8Tx_149_329 (CanHwFilter): CanHwFilterMask=2049, CanHwFilterCode=2049
        CanHardwareObject_T_CanFrame_TC24U8Tx_14A_330: CanHwObjectCount=20, CanObjectType=TRANSMIT, CanObjectId=29
          CanHwFilter_T_CanFrame_TC24U8Tx_14A_330 (CanHwFilter): CanHwFilterMask=2049, CanHwFilterCode=2049
        CanHardwareObject_R_CanFrame_TC25U8RX_12E_302: CanHwObjectCount=21, CanObjectType=RECEIVE, CanObjectId=8
          CanHwFilter_R_CanFrame_TC25U8RX_12E_302 (CanHwFilter): CanHwFilterMask=2049, CanHwFilterCode=2049
        CanHardwareObject_T_CanFrame_TC26Arr8Tx_12F_303: CanHwObjectCount=22, CanObjectType=TRANSMIT, CanObjectId=30
          CanHwFilter_T_CanFrame_TC26Arr8Tx_12F_303 (CanHwFilter): CanHwFilterMask=2049, CanHwFilterCode=2049
        CanHardwareObject_T_CanFrame_TC27Arr8Tx_130_304: CanHwObjectCount=23, CanObjectType=TRANSMIT, CanObjectId=31
          CanHwFilter_T_CanFrame_TC27Arr8Tx_130_304 (CanHwFilter): CanHwFilterMask=2049, CanHwFilterCode=2049
        CanHardwareObject_T_CanFrame_TC28Arr8Tx_252_594: CanHwObjectCount=24, CanObjectType=TRANSMIT, CanObjectId=32
          CanHwFilter_T_CanFrame_TC28Arr8Tx_252_594 (CanHwFilter): CanHwFilterMask=2049, CanHwFilterCode=2049
        CanHardwareObject_T_CanFrame_TC29Arr8Tx_253_595: CanHwObjectCount=25, CanObjectType=TRANSMIT, CanObjectId=33
          CanHwFilter_T_CanFrame_TC29Arr8Tx_253_595 (CanHwFilter): CanHwFilterMask=2049, CanHwFilterCode=2049
        CanHardwareObject_T_CanFrame_TC30Arr8Tx_14B_331: CanHwObjectCount=26, CanObjectType=TRANSMIT, CanObjectId=34
          CanHwFilter_T_CanFrame_TC30Arr8Tx_14B_331 (CanHwFilter): CanHwFilterMask=2049, CanHwFilterCode=2049
        CanHardwareObject_T_CanFrame_TC31Arr8Tx_14C_332: CanHwObjectCount=27, CanObjectType=TRANSMIT, CanObjectId=35
          CanHwFilter_T_CanFrame_TC31Arr8Tx_14C_332 (CanHwFilter): CanHwFilterMask=2049, CanHwFilterCode=2049
        CanHardwareObject_R_CanFrame_TC34U8Rx_132_306: CanHwObjectCount=28, CanObjectType=RECEIVE, CanObjectId=9
          CanHwFilter_R_CanFrame_TC34U8Rx_132_306 (CanHwFilter): CanHwFilterMask=2049, CanHwFilterCode=2049
        CanHardwareObject_T_CanFram_TC36U8Tx_133_307: CanHwObjectCount=29, CanObjectType=TRANSMIT, CanObjectId=36
          CanHwFilter_T_CanFram_TC36U8Tx_133_307 (CanHwFilter): CanHwFilterMask=2049, CanHwFilterCode=2049
        CanHardwareObject_T_CanFrame_TC37U8Tx_254_596: CanHwObjectCount=30, CanObjectType=TRANSMIT, CanObjectId=37
          CanHwFilter_T_CanFrame_TC37U8Tx_254_596 (CanHwFilter): CanHwFilterMask=2049, CanHwFilterCode=2049
        CanHardwareObject_R_CanFrame_TC38U8Rx_134_308: CanHwObjectCount=31, CanObjectType=RECEIVE, CanObjectId=10
          CanHwFilter_R_CanFrame_TC38U8Rx_134_308 (CanHwFilter): CanHwFilterMask=2049, CanHwFilterCode=2049
        CanHardwareObject_R_CanFrame_TC39Arr8Rx_135_309: CanHwObjectCount=32, CanObjectType=RECEIVE, CanObjectId=11
          CanHwFilter_R_CanFrame_TC39Arr8Rx_135_309 (CanHwFilter): CanHwFilterMask=2049, CanHwFilterCode=2049
        CanHardwareObject_T_CanFrame_TC3U8Tx_120_288: CanHwObjectCount=33, CanObjectType=TRANSMIT, CanObjectId=38
          CanHwFilter_T_CanFrame_TC3U8Tx_120_288 (CanHwFilter): CanHwFilterMask=2049, CanHwFilterCode=2049
        CanHardwareObject_R_CanFrame_TC40U8Rx_136_310: CanHwObjectCount=34, CanObjectType=RECEIVE, CanObjectId=12
          CanHwFilter_R_CanFrame_TC40U8Rx_136_310 (CanHwFilter): CanHwFilterMask=2049, CanHwFilterCode=2049
        CanHardwareObject_R_CanFrame_TC41U8Rx_137_311: CanHwObjectCount=35, CanObjectType=RECEIVE, CanObjectId=13
          CanHwFilter_R_CanFrame_TC41U8Rx_137_311 (CanHwFilter): CanHwFilterMask=2049, CanHwFilterCode=2049
        CanHardwareObject_T_CanFrame_TC5ArrTx_121_289: CanHwObjectCount=36, CanObjectType=TRANSMIT, CanObjectId=39
          CanHwFilter_T_CanFrame_TC5ArrTx_121_289 (CanHwFilter): CanHwFilterMask=2049, CanHwFilterCode=2049
        CanHardwareObject_R_CanFrame_TC6U8Rx_122_290: CanHwObjectCount=37, CanObjectType=RECEIVE, CanObjectId=14
          CanHwFilter_R_CanFrame_TC6U8Rx_122_290 (CanHwFilter): CanHwFilterMask=2049, CanHwFilterCode=2049
        CanHardwareObject_R_CanFrame_TC7Arr8Rx_123_291: CanHwObjectCount=38, CanObjectType=RECEIVE, CanObjectId=15
          CanHwFilter_R_CanFrame_TC7Arr8Rx_123_291 (CanHwFilter): CanHwFilterMask=2049, CanHwFilterCode=2049
        CanHardwareObject_T_CanFrame_TC8DynArruint8_124_292: CanHwObjectCount=39, CanObjectType=TRANSMIT, CanObjectId=40
          CanHwFilter_T_CanFrame_TC8DynArruint8_124_292 (CanHwFilter): CanHwFilterMask=2049, CanHwFilterCode=2049
        CanHardwareObject_R_CanFrame_TC9DynArruint8_125_293: CanHwObjectCount=40, CanObjectType=RECEIVE, CanObjectId=16
          CanHwFilter_R_CanFrame_TC9DynArruint8_125_293 (CanHwFilter): CanHwFilterMask=2049, CanHwFilterCode=2049
      CanCommunicationController_0 (CanController):
        CanControllerId = 0
        CanWakeupSupport = false
        CanWakeupFunctionalityAPI = false
        CanControllerBaseAddress = 0
        CanControllerActivation = true
        CanBusoffProcessing = 
        CanRxProcessing = 
        CanTxProcessing = 
        CanWakeupProcessing = 
        CanCpuClockRef = (unset)
        CanControllerDefaultBaudrate = CanControllerBaudrateConfig_0
        CanControllerBaudrateConfig_0 (CanControllerBaudrateConfig):
          CanControllerBaudRateConfigID = 0
          CanControllerBaudRate = 500
          CanControllerPropSeg = (unset)
          CanControllerSeg1 = (unset)
          CanControllerSeg2 = (unset)
          CanControllerSyncJumpWidth = (unset)
      CanIcom
        CanIcomConfig: CanIcomWakeOnBusOff=true, CanIcomConfigId=1
          CanIcomWakeupCause (CanIcomWakeupCauses)
            CanIcomRxMessage: CanIcomPayloadLengthError=false, CanIcomCounterValue=2047, CanIcomMessageId=8388607, CanIcomMessageIdMask=8388607
              CanIcomRxMessageSignalConfig: CanIcomSignalMask=(unset), CanIcomSignalOperation=, CanIcomSignalValue=(unset)
    CanGeneral_0 (CanGeneral):
      CanIndex = 0
      CanDevErrorDetection = false
      CanVersionInfoApi = false
      CanPublicIcomSupport = false
      CanSetBaudrateApi = false
      CanMultiplexedTransmission = true
      CanMainFunctionModePeriod = 0.001
      CanTimeoutDuration = (unset)
      CanSupportTTCANRef = (unset)
      CanIcomGeneral: CanIcomVariant=CAN_ICOM_VARIANT_NONE, CanIcomLevel=CAN_ICOM_LEVEL_ONE
      CanMainFunctionRWPeriods: CanMainFunctionPeriod=(unset)
  module config CanIf_0: definition=CanIf, ecuc-def-edition=4.2.2, implementation-config-variant=VARIANT-PRE-COMPILE, module-description=CanIf_Impl
    CanIfCtrlDrvCfg_0 (CanIfCtrlDrvCfg): CanIfCtrlDrvInitHohConfigRef=(unset), CanIfCtrlDrvNameRef=(unset)
      CanIfCtrlCfg_0 (CanIfCtrlCfg): CanIfCtrlId=(unset), CanIfCtrlWakeupSupport=false, CanIfCtrlCanCtrlRef=(unset)
    CanIfDispatchCfg_0 (CanIfDispatchCfg): CanIfDispatchUserCtrlBusOffUL=, CanIfDispatchUserCtrlModeIndicationUL=
    CanIfInitCfg_0 (CanIfInitCfg): CanIfInitCfgSet=(unset)
    CanIfPrivateCfg_0 (CanIfPrivateCfg): CanIfPrivateDlcCheck=true, CanIfPrivateSoftwareFilterType=, CanIfSupportTTCAN=false
    CanIfPublicCfg_0 (CanIfPublicCfg):
      CanIfPublicCancelTransmitSupport = (unset)
      CanIfPublicDevErrorDetect = true
      CanIfPublicHandleTypeEnum = 
      CanIfPublicIcomSupport = false
      CanIfPublicMultipleDrvSupport = true
      CanIfPublicPnSupport = false
      CanIfPublicReadRxPduDataApi = false
      CanIfPublicReadRxPduNotifyStatusApi = false
      CanIfPublicReadTxPduNotifyStatusApi = false
      CanIfPublicSetDynamicTxIdApi = false
      CanIfPublicTxBuffering = false
      CanIfPublicTxConfirmPollingSupport = (unset)
      CanIfPublicVersionInfoApi = true
      CanIfPublicWakeupCheckValidSupport = false
      CanIfTriggerTransmitSupport = true
      CanIfTxOfflineActiveSupport = false
      CanIfWakeupSupport = true
  module config Com_0: definition=Com, ecuc-def-edition=4.2.2, implementation-config-variant=VARIANT-PRE-COMPILE, module-description=COM_Impl
    ComConfig_0 (ComConfig)
      ComTimeBase_0 (ComTimeBase)
    ComGeneral_0 (ComGeneral): ComEnableSignalGroupArrayApi=false, ComSupportedIPduGroups=(unset), ComVersionInfoApi=(unset)
